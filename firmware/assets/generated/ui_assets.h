// ui_assets.h - generated by Flipper UI Studio. Put it in firmware/assets/generated/ once;
// every exported pic_/icon_/mock_/anim_/font_ header and the firmware/assets/assets.cpp tables build on it.
//
// Pictures, icons, mockups, animation frames: RGB565, one uint16_t per pixel, idx = y*w + x.
// UI_TRANSPARENT (0xF81F) marks pixels that are not drawn. A real pixel of that color was moved to
// 0xF83F at export, so the key never hides art.
// Fonts: 1bpp masks, idx = y*w + x, byte = idx/8, bit = idx%8 (LSB-first), 1 = ink; the caller picks the color.
//
// Drawing targets TFT_eSPI (a TFT_eSprite works the same). The arrays hold the 16-bit values in the CPU's own
// byte order, so call tft.setSwapBytes(true) once after tft.init() - pushImage() then sends them in the
// panel's big-endian order.
#pragma once

#include <Arduino.h>
#include <TFT_eSPI.h>
#include <string.h>

// ---------- asset tables ----------
struct PicEntry {            // pictures, icons, mockups
  const char* name;
  const uint16_t* data;      // w*h RGB565 values in PROGMEM
  uint16_t w, h;
};

struct GifEntry {            // multi-frame animations (boot animation, animated icons)
  const char* name;
  const uint16_t* const* frames;
  int frameCount;
  unsigned long frameDelayMs;
  uint16_t w, h;
};

struct FontEntry {           // fixed-cell bitmap fonts; glyph n = glyphs + n * ((w*h+7)/8)
  const char* name;
  const uint8_t* glyphs;
  const char* charset;       // charset[n] is the character glyph n draws
  uint8_t w, h;
  uint16_t count;
};

constexpr uint16_t UI_TRANSPARENT = 0xF81F;

// ---------- screen + layout (legacy: derived from the Studio's built-in templates; new code reads ui_templates.h) ----------
constexpr int16_t UI_SCREEN_W = 128;
constexpr int16_t UI_SCREEN_H = 160;
constexpr int16_t UI_PAD = 2;

// Status bar: on List, Detail and Text-input screens, off on Canvas/Game (full 160 px).
// Rows 0-10 hold content, row 11 is the rule. Left slot: clock on the home menu once time is
// synced, otherwise the current screen's title. Right slot, right to left: battery, then WiFi / BT
// icons only while that radio is on.
constexpr int16_t UI_STATUS_H = 12;
constexpr int16_t UI_STATUS_ICON = 8;

// List: 16 px rows, 12x12 icon at x=2, label at x=18, selected row highlighted. Labels longer
// than UI_LIST_LABEL_CHARS scroll on the selected row and are clipped on the others. The 3 px
// scrollbar only appears when the list has more rows than fit.
constexpr int16_t UI_LIST_ROW_H = 16;
constexpr int16_t UI_LIST_ICON = 12;
constexpr int16_t UI_LIST_TEXT_X = 18;
constexpr int16_t UI_SCROLLBAR_W = 3;
constexpr int16_t UI_LIST_VISIBLE = (UI_SCREEN_H - UI_STATUS_H) / UI_LIST_ROW_H;             // 9
constexpr int16_t UI_LIST_LABEL_CHARS = (UI_SCREEN_W - UI_LIST_TEXT_X - UI_SCROLLBAR_W - 1) / 8; // 13

// Detail / Info: 12 px title row in the large font, then 10 px label/value rows in the small font
// (label left, value right-aligned). A value that doesn't fit takes the whole next row.
constexpr int16_t UI_TITLE_H = 12;
constexpr int16_t UI_DETAIL_ROW_H = 10;

// Text input: title row, 16 px field, single-row character carousel 18 px tall at the bottom.
constexpr int16_t UI_INPUT_BOX_H = 16;
constexpr int16_t UI_CAROUSEL_H = 18;

// Fonts: large 8x8 (menus, titles, input), small 6x8 (status bar, labels, values).
constexpr uint8_t UI_FONT_LARGE_W = 8, UI_FONT_LARGE_H = 8;
constexpr uint8_t UI_FONT_SMALL_W = 6, UI_FONT_SMALL_H = 8;

// ---------- drawing ----------
inline void uiDrawPic(TFT_eSPI& tft, int32_t x, int32_t y, const PicEntry& p) {
  tft.pushImage(x, y, p.w, p.h, p.data, UI_TRANSPARENT);
}

inline void uiDrawGifFrame(TFT_eSPI& tft, int32_t x, int32_t y, const GifEntry& a, int frame) {
  tft.pushImage(x, y, a.w, a.h, a.frames[frame % a.frameCount], UI_TRANSPARENT);
}

inline bool uiBit(const uint8_t* data, uint32_t idx) {
  return pgm_read_byte(data + (idx >> 3)) & (1 << (idx & 7));
}

// Draws the set bits of a w*h mask in color c, one horizontal run at a time.
inline void uiDrawBits(TFT_eSPI& tft, int32_t x, int32_t y, const uint8_t* data,
                       uint16_t w, uint16_t h, uint16_t c) {
  for (uint16_t yy = 0; yy < h; yy++) {
    int32_t run = -1;
    for (uint16_t xx = 0; xx <= w; xx++) {
      const bool lit = xx < w && uiBit(data, (uint32_t)yy * w + xx);
      if (lit && run < 0) {
        run = xx;
      } else if (!lit && run >= 0) {
        tft.drawFastHLine(x + run, y + yy, xx - run, c);
        run = -1;
      }
    }
  }
}

// Returns the x after the last character. Characters missing from the font advance but draw nothing.
inline int32_t uiDrawText(TFT_eSPI& tft, const FontEntry& f, int32_t x, int32_t y,
                          const char* s, uint16_t c) {
  const uint16_t bytesPerGlyph = (f.w * f.h + 7) / 8;
  for (; *s; s++, x += f.w) {
    const char* hit = strchr(f.charset, *s);
    if (hit) uiDrawBits(tft, x, y, f.glyphs + (hit - f.charset) * bytesPerGlyph, f.w, f.h, c);
  }
  return x;
}

inline int16_t uiTextWidth(const FontEntry& f, const char* s) { return (int16_t)strlen(s) * f.w; }
